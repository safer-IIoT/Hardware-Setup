#pragma once
// ---------------------------------------------------------------------------
// MQ-2 gas classifier for the ESP32-S3: multinomial logistic regression on one
// packet of 15 consecutive raw MQ-2 readings (1 reading per second).
// Generated by train_mq2_lr.py from MultimodalGasData (doi:10.17632/zkwgkjkjn9.2).
//
//   float buf[mq2lr::WINDOW];              // readings in dataset counts (see below)
//   float p[mq2lr::N_CLASSES];
//   mq2lr::GasClass c = mq2lr::classify(buf, p);
//
// INPUT SCALE: the model was trained on the dataset's raw readings, which are
// 10-bit counts (0..1023) of the MQ-2 output on a 5 V board. Convert the S3's
// reading with countsFromMilliVolts() (use analogReadMilliVolts(), and set the
// divider ratio of your MQ-2 -> GPIO divider). If your sensor's clean-air
// level differs from the dataset's, retrain or recalibrate.
//
// Held-out accuracy (4 classes, chance 0.25):
//   blocked 5-fold CV                  0.701
//   70/30 split by blocks (20 repeats) 0.685 +/- 0.036
//   70/30 chronological                0.596
// ---------------------------------------------------------------------------
#include <math.h>
#include <stdint.h>

namespace mq2lr {

static const uint8_t WINDOW = 15;
static const uint8_t N_FEATURES = 10;
static const uint8_t N_CLASSES = 4;
enum GasClass : uint8_t { NO_GAS = 0, PERFUME = 1, SMOKE = 2, MIXTURE = 3 };
static const char* const CLASS_NAMES[N_CLASSES] = { "NoGas", "Perfume", "Smoke", "Mixture" };

// Feature order: mean, min, max, std, slope, delta, last, mean_abs_step, max_step, min_step
static const float MU[N_FEATURES] = { 678.30971f, 655.99727f, 703.19731f, 15.810837f, -0.012098344f, -0.1497093f, 678.0625f, 4.8022218f, 17.416969f, -10.789244f };
static const float SD[N_FEATURES] = { 88.663757f, 93.386517f, 85.73124f, 15.577316f, 4.1390769f, 54.04855f, 91.786234f, 4.7236319f, 27.766619f, 14.07522f };
static const float W[N_CLASSES][N_FEATURES] = {
  /* NoGas    */ { 0.70748749f, 0.61073009f, 2.5837968f, -0.2422593f, 0.74617583f, 0.40141533f, -1.9204314f, -4.2239746f, 1.5865746f, 0.063304215f },
  /* Perfume  */ { 1.8332837f, -2.2949654f, 0.6564455f, 1.0607298f, -0.2279681f, 0.30019619f, 1.5231445f, -4.4305697f, 1.145999f, -0.73620396f },
  /* Smoke    */ { -0.93881387f, 0.94545304f, 0.83616922f, -0.44910334f, -0.13755652f, 0.16465596f, -1.9716321f, 2.0115639f, -0.29355907f, 0.2149491f },
  /* Mixture  */ { -1.6019574f, 0.73878227f, -4.0764116f, -0.36936715f, -0.3806512f, -0.86626748f, 2.368919f, 6.6429805f, -2.4390145f, 0.45795065f },
};
static const float B[N_CLASSES] = { -0.76717295f, 0.016228451f, 1.4049097f, -0.65396519f };

// Dataset counts from the voltage at the S3 pin.
//   dividerRatio = V_sensor / V_pin   (e.g. 10k/20k divider on a 5 V MQ-2 -> 1.5)
inline float countsFromMilliVolts(float mvAtPin, float dividerRatio) {
  return mvAtPin * dividerRatio * (1023.0f / 5000.0f);
}

// Features of one packet. Must match features() in train_mq2_lr.py.
inline void extractFeatures(const float* w, float* x) {
  const uint8_t n = WINDOW;
  float sum = 0, mn = w[0], mx = w[0];
  for (uint8_t i = 0; i < n; i++) { sum += w[i]; if (w[i] < mn) mn = w[i]; if (w[i] > mx) mx = w[i]; }
  float mean = sum / n, tm = 0.5f * (n - 1), ss = 0, sxy = 0, sxx = 0;
  for (uint8_t i = 0; i < n; i++) {
    float dt = i - tm, dy = w[i] - mean;
    ss += dy * dy; sxy += dt * dy; sxx += dt * dt;
  }
  float absStep = 0, maxStep = -1e30f, minStep = 1e30f;
  for (uint8_t i = 1; i < n; i++) {
    float d = w[i] - w[i - 1];
    absStep += fabsf(d);
    if (d > maxStep) maxStep = d;
    if (d < minStep) minStep = d;
  }
  x[0] = mean; x[1] = mn; x[2] = mx; x[3] = sqrtf(ss / n); x[4] = sxy / sxx;
  x[5] = w[n - 1] - w[0]; x[6] = w[n - 1]; x[7] = absStep / (n - 1); x[8] = maxStep; x[9] = minStep;
}

// Classify one packet of WINDOW readings. probs (optional) receives the softmax output.
inline GasClass classify(const float* window, float* probs = nullptr) {
  float x[N_FEATURES], z[N_CLASSES], zmax = -1e30f;
  extractFeatures(window, x);
  for (uint8_t i = 0; i < N_FEATURES; i++) x[i] = (x[i] - MU[i]) / SD[i];
  uint8_t best = 0;
  for (uint8_t k = 0; k < N_CLASSES; k++) {
    float a = B[k];
    for (uint8_t i = 0; i < N_FEATURES; i++) a += W[k][i] * x[i];
    z[k] = a;
    if (a > zmax) { zmax = a; best = k; }
  }
  if (probs) {
    float s = 0;
    for (uint8_t k = 0; k < N_CLASSES; k++) { probs[k] = expf(z[k] - zmax); s += probs[k]; }
    for (uint8_t k = 0; k < N_CLASSES; k++) probs[k] /= s;
  }
  return static_cast<GasClass>(best);
}

}  // namespace mq2lr
